## kernel/Documentation/devicetree/bindings/net/marvell-orion-mdio.txt
```
* Marvell MDIO Ethernet Controller interface

The Ethernet controllers of the Marvel Kirkwood, Dove, Orion5x,
MV78xx0, Armada 370 and Armada XP have an identical unit that provides
an interface with the MDIO bus. This driver handles this MDIO
interface.

Required properties:
- compatible: "marvell,orion-mdio"
              "marvell,bobk-pp-mdio" - for BobK/BC2 SMI indirect access
- reg: address and length of the SMI register

Optional properties:
- interrupts: interrupt line number for the SMI error/done interrupt
- clocks: Phandle to the clock control device and gate bit
- smi-indirect-access: indirect SMI access from MSYS to switch core (
                       for BobK/BC2)
- pp-smi-base: base address of the PP SMI register
- pp-smi-interface: PP SMI interface connected to external phy (only
                    used for smi indirect access)

The child nodes of the MDIO driver are the individual PHY devices
connected to this MDIO bus. They must have a "reg" property given the
PHY address on the MDIO bus.

Example at the SoC level:

mdio {
	#address-cells = <1>;
	#size-cells = <0>;
	compatible = "marvell,orion-mdio";
	reg = <0xd0072004 0x4>;
};

And at the board level:

mdio {
	phy0: ethernet-phy@0 {
		reg = <0>;
	};

	phy1: ethernet-phy@1 {
		reg = <1>;
	};
}

Example (PP SMI0 indirect access)

At the SoC level:

ranges = <MBUS_ID(0x03, 0x00) 0 0 0xf8000000 0x4000000>;

mdio {
	#address-cells = <1>;
	#size-cells = <0>;
	compatible = "marvell,bobk-pp-mdio";
	reg = <MBUS_ID(0x03, 0x00) 0 0x200>;
	smi-indirect-access;
	pp-smi-base = <0x54000000>
	pp-smi-interface = <0>;
};
```

## kernel/drivers/misc/mvebu/Kconfig
```kconfig
#
# Marvell misc devices
#

if ARCH_MVEBU || ARCH_MSYS

menu "Marvell misc devices"
config MVEBU_CM3
	tristate "Marvell cm3 device"
	depends on MACH_MSYS
	---help---
	  This option enables support for Marvell cm3 driver. The CM3 CPU is
	  a offloading co-processor integrated with Marvell MSYS SoCs.

	  If unsure, say N.

config MV_CM3_IPC_SUPPORT
	tristate "CM3 IPC support"
	depends on MVEBU_CM3
	select MV_IPC_FREERTOS_DRIVER
	---help---
	  This option enables communication between the Host CPU to the
	  FreeRTOS system on CM3 via IPC infrastucture.

	  If unsure, say N.

config MV_IPC_FREERTOS_DRIVER
	tristate "FreeRTOS IPC Infrastructure support"
	depends on MACH_MSYS
	---help---
	  This option enables support for Marvell IPC infrastructure.
	  It allows to use IPC service to communicate with the FreeRTOS
	  system on CM3, Dragonite and ServiceCPU in AMP mode.
	  Need to enable the individual configuration in the
	  CM3/Dragonite/ServiceCPU driver.

	  If unsure, say N.

config MV_INCLUDE_DRAGONITE_XCAT
	tristate "Marvell dragonite device"
	depends on MACH_MSYS
	select MSYS_ADDR_COMPL
	default y
	---help---
	  This option enables support for Marvell dragonite driver.
	  The dragonite CPU is a offloading co-processor integrated
	  with Marvell MSYS SoCs.
	  The host CPU and the dragonite CPU share ITCM and DTCM.

config DRAGONITE_JTAG_ENABLE
	bool "Enables JTAG debugging for dragonite"
	default n
	depends on MV_INCLUDE_DRAGONITE_XCAT
	---help---
	Selects if the dragonite JTAG debug is enabled.
	if selected JATG debugging is enabled for dragonite
	and disabled for main CPU. If not selected, JATG debugging
	is disabled for dragonite and enabled for main CPU

config MV_DRAGONITE_IPC_SUPPORT
	bool "dragonite IPC support"
	depends on MV_INCLUDE_DRAGONITE_XCAT
	select MV_IPC_FREERTOS_DRIVER
	default y
	---help---
	This option enables communication between the Host CPU
	to the FreeRTOS system on dragonite xcat via IPC
	infrastucture.
	If unsure, say N.

config MSYS_ADDR_COMPL
	depends on MACH_MSYS
	bool "Address completion support"
	---help---
	Whether support address completion.

config MV_INCLUDE_SERVICECPU
	bool "MSYS Service CPU Support"
	depends on MACH_ARMADA_380
	select MV_INCLUDE_PRESTERA_PCI
	---help---
	The Service CPU is a dedicated CPU core which runs Marvell developed firmware;
	the firmware target is to use the internal CPU power to extend
	switch Hardwarecapabilities by performing tasks which otherwise
	had to be developed by customer and run at the host CPU;
	this option enables support for running Service CPU firmware
	on the first core of MSYS CPU over the PCIe bus;
	the platform is based on PEX connectivity via XBAR between
	external CPU and single PP device;
	this option is based on prestera PCI feature.

config MV_SERVICECPU_IPC_SUPPORT
	bool "serviceCPU IPC support"
	depends on MV_INCLUDE_SERVICECPU
	select MV_IPC_FREERTOS_DRIVER
	default y
	---help---
	This option enables support for Marvell IPC driver on serviceCPU.
	It allows to use IPC to the FreeRTOS system (on serviceCPU).

endmenu
endif #ARCH_MVEBU || ARCH_MSYS
```

## kernel/drivers/net/ethernet/mvebu_net/prestera/Kconfig
```kconfig
config MV_INCLUDE_PRESTERA
	bool "Prestera Switch Support"
	depends on ARCH_MVEBU
#	select MV_INCLUDE_PRESTERA_PCI if MACH_ARMADA_XP_AMC
	default y
	help
	Add Prestera mvPP char device driver support,
	used by user space to configure and interact with
	Prestera Packet Procesors, supporting switches connected
	via PCIe to AMC/AXP and MSYS.
	This option should be enabled when using CPSS.

config MV_SET_LINK_DOWN_DELAY
        int "Set the link down delay in ms"
        range 3000 120000
        depends on MV_INCLUDE_PRESTERA
        default "3000"
        help
        Modify the default link down delay for allowing faster
        ROS bring up in case the management port is not UP
        and the IP address is yet not assigned to it.

config MV_INCLUDE_PRESTERA_PCI
	bool "Prestera Switch Support for PCI endpoint"
	depends on MV_INCLUDE_PRESTERA
	default y
	help
	this option increase virtual memory
	allocation in case of ARMADA XP AMC
	board for CPSS devices connected to
	PCI switch

config MV_INCLUDE_PRESTERA_KERNELEXT
	tristate "Prestera mvKernelExt"
	depends on MV_INCLUDE_PRESTERA
	default y
	help
	Add Prestera mvKernelExt char device driver support,
	used by user space to configure and interact with
	Prestera Packet Processors, supporting switches connected
	via PCIe to AMC/AXP and MSYS.
	This option should be enabled when using CPSS.


config MV_FORCE_CPSS_BOARD_ID_PRESTERA_IOCTL
	bool "Force Prestera CPSS Board ID in IOCTL"
	depends on MV_INCLUDE_PRESTERA
	default n
	---help---
	Force the prestera Board ID returned by IOCTL.

	This option enables enforcement of Prestera Board ID returned by
	PRESTERA_IOC_GETBOARDID instead of reading a real ID from
	Marvell on-board EEPROM.
	Select this option when using non-Marvell boards without on-board
	EEPROM or for bringing up new systems with not yet supported IDs.

config  MV_FORCED_CPSS_BOARD_ID_VALUE
	hex "Prestera enforced CPSS Board ID value"
	depends on MV_FORCE_CPSS_BOARD_ID_PRESTERA_IOCTL
	# the default value of 0x50 represents DB_BOBK_ID
	default 0x50
	---help---
	Prestera enforced Board ID value.

	Specifies the Board ID to be returned by Prestera driver
	PRESTERA_IOC_GETBOARDID call when the Board ID enforcement is active.
```
